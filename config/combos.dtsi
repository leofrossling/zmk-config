// indebted and with much reference to dxmh's zmk-config

compatible = "zmk,combos";
#define LONG_TIMEOUT_MS 100
#define NORMAL_LAYERS 0 1 2 3 4 5
#define LOCK_LAYER 6

#define COMBO(NAME, BINDINGS, KEYPOS) \
  combo_##NAME { \
    bindings = <BINDINGS>; \
    key-positions = <KEYPOS>; \
    layers = <NORMAL_LAYERS>; \
  };

#define COMBO_LONG(NAME, BINDINGS, KEYPOS) \
  combo_##NAME { \
    bindings = <BINDINGS>; \
    key-positions = <KEYPOS>; \
    layers = <NORMAL_LAYERS>; \
    timeout-ms = <LONG_TIMEOUT_MS>; \
  };

#define LAYER_COMBO(NAME, BINDINGS, KEYPOS, LAYERS) \
  combo_##NAME { \
    bindings = <BINDINGS>; \
    key-positions = <KEYPOS>; \
    layers = <LAYERS>; \
  };

/*           34 Keys
╭──────────────╮ ╭──────────────╮
│ 0  1  2  3  4│ │ 5  6  7  8  9│
│10 11 12 13 14│ │15 16 17 18 19│
│20 21 22 23 24│ │25 26 27 28 29│
╰────────╮30 31│ │32 33╭────────╯
         ╰─────╯ ╰─────╯         */

COMBO(tab, &kp TAB, 1 2)
COMBO(shift, &skq LSHFT, 7 8)
COMBO(ctrl, &sk LCTL, 21 22)
COMBO(backspace, &kp BSPC, 27 28)
COMBO(cmd, &sk LCMD, 30 31)
COMBO(opt, &sk LALT, 32 33)
COMBO(q, &kp Q, 1 3)
//COMBO(z, &kp Z, 21 23)
COMBO_LONG(capsword, &caps_word, 14 15)
LAYER_COMBO(lock, &tog LCK, 20 29 30 33, NORMAL_LAYERS LOCK_LAYER)

combo_swe_one {
  compatible = "zmk,behavior-macro";
  key_positions = 21 23;
  label = "swe one";
  #binding-cells = <0>;
  wait-ms = <U_WAIT_MS>;
  tap-ms = <U_TAP_MS>;
  bindings
    = <&macro_press   &kp LALT>
    , <&macro_tap     &kp KP_N0 &kp KP_N2 &kp KP_N2 &kp KP_N9>
    , <&macro_release &kp LALT>;
};